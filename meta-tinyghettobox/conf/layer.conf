## meta-tinyghettobox/conf/layer.conf
```bitbake
# We have a conf and classes directory, add to BBPATH
BBPATH .= ":${LAYERDIR}"

# We have recipes-* directories, add to BBFILES
BBFILES += "${LAYERDIR}/recipes-*/*/*.bb \
            ${LAYERDIR}/recipes-*/*/*.bbappend"

BBFILE_COLLECTIONS += "tinyghettobox"
BBFILE_PATTERN_tinyghettobox = "^${LAYERDIR}/"
BBFILE_PRIORITY_tinyghettobox = "6"

LAYERDEPENDS_tinyghettobox = "core"
LAYERSERIES_COMPAT_tinyghettobox = "scarthgap"
```

## meta-tinyghettobox/wic/tgb-raspberrypi.wks
```
# gpt-image.wks
bootloader --ptable msdos

part /boot --source bootimg-partition --fstype vfat --align 4096 --size 64M
part rootfs_a --source rootfs --fstype squashfs --align 4096 --extra-space 100M
part rootfs_b --source rootfs --fstype squashfs --align 4096 --extra-space 100M
part userdata --fstype ext4 --size 128M --align 4096
```

## meta-tinyghettobox/wic/tgb-sdimage-raspberrypi.wks
```
bootloader --ptable gpt

# Boot partition
part /boot --source bootimg-partition --fstype=vfat --part-name boot --align 4096 --size 32M --ondisk mmcblk0

# Root partition using squashfs
part /rootfs_b --source rootfs --fstype=squashfs --align 4096 --part-name rootfs_a --ondisk mmcblk0
part /rootfs_b --size 1M --align 4096 --part-name rootfs_b --ondisk mmcblk0

# Optional: Add an extra partition for user data if needed
part --fstype=ext4 --part-name userdata --align 4096 --size 128M --ondisk mmcblk0
```

## meta-tinyghettobox/wic/tgb-usbimage-raspberrypi.wks
```
bootloader --ptable gpt

# Boot partition
part /boot --source bootimg-partition --fstype=vfat --part-name boot --align 4096 --size 32M --ondisk sda

# Root partition using squashfs
part / --source rootfs --fstype=squashfs --align 4096 --part-name rootfs_a --ondisk sda
part --size 1M --align 4096 --part-name rootfs_b --ondisk sda

# Optional: Add an extra partition for user data if needed
part --fstype=ext4 --part-name userdata --align 4096 --size 128M --ondisk sda
```
